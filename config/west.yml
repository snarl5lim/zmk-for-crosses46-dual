## config/west.yml
```yaml
manifest:
  remotes:
    - name: zmkfirmware
      url-base: https://github.com/zmkfirmware
    - name: SolidAlloy
      url-base: https://github.com/SolidAlloy
      
  projects:
    - name: zmk
      remote: zmkfirmware
      # Pulling the latest OS which contains native trackball drivers
      revision: main
      import: app/west.yml
      
    - name: gggw-zmk-keebs
      remote: SolidAlloy
      # Using the specific branch designed for the modern native driver
      revision: zephyr-4.1
      import: config/west.yml
      
  self:
    path: config
    
```
